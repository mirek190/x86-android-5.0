## linux/modules/drivers/input/touchscreen/ilitek/Kconfig
```kconfig
config TOUCHSCREEN_ILITEK
	tristate "ILITEK touchscreen controllers"
	depends on I2C
	help
	  Say Y here if you want to support ILITEK
	  touchscreen controller.
```

## linux/modules/wlan/realtek/rtl8189/Kconfig
```kconfig
config RTL8189ES
        tristate "Realtek 8189ES SDIO or SPI WiFi"
        ---help---
          Help message of RTL8189ES

config WLAN_SDIO
        bool "Enable SDIO interface for Realtek"
        depends on RTL8723AS || RTL8723BS || RTL8189ES
        default n
        ---help---
          Use memory preallocated in platform
```
