## device/intel/common/kdump_defconfig
```kconfig
# CONFIG_DRM_I915 is not set
# CONFIG_DRM_I915_KMS is not set
# CONFIG_DRM_I915_SYNC is not set
CONFIG_PROC_VMCORE=y
CONFIG_CRASH_DUMP=y
CONFIG_RELOCATABLE=y
```

## linux/kernel/drivers/gpu/drm/i915/Kconfig
```kconfig
config DSI_MODE_NT35521_QC7_3G069I
	tristate "lcd qc7 1280*800"
	default n
	
config DSI_MODE_P088PW_3G081I
	tristate "lcd qc7 1280*800"
	default n
	
config DSI_MODE_NT35521_QC10_3G085I
	tristate "lcd qc10 1280*800"
	default n

config DSI_MODE_KW080KD_3G080IH
	tristate "DSI_MOD_KW080KD"
	default n
config DSI_MODE_KW101JEA_3G086I
	tristate "DSI_MODE_KW101JEA_3G086I"
	default n
config DSI_MODE_AUO_3G086I
	tristate "DSI_MODE_AUO_3G086I"
	default n
config DSI_MODE_EDP_IPAD2_3G068I
	tristate "lcd IPAD2 2048*1536"
	default n
config DSI_MODE_EDP_IPAD2_3G062I
	tristate "lcd IPAD2 2048*1536"
	default n
config DSI_MODE_KD080D14_H8I
	tristate "DSI_MOD_KW080KD"
	default n
config DSI_MODE_LSL1080A102_NB31
	tristate "DSI_MODE_LSL1080A102"
	default n
		
```

## linux/kernel/drivers/input/touchscreen/focaltech/Kconfig
```kconfig
config TOUCHSCREEN_FOCALTECH
	tristate "Focaltech touchscreen controllers"
	depends on I2C
	help
	  Say Y here if you want to support Focaltech
	  touchscreen controller.
```

## linux/modules/camera/drivers/media/i2c/Kconfig
```kconfig
#
# Kconfig for vcm drivers
#
config VCM_VM149
       tristate "VCM vm149 support"
       depends on I2C && VIDEO_V4L2
       ---help---
         This is a Video4Linux2 sensor-level driver for the vm149.

         It currently only works with the atomisp driver.

config VCM_DW9714
       tristate "VCM dw9714 support"
       depends on I2C && VIDEO_V4L2
       ---help---
         This is a Video4Linux2 sensor-level driver for the dw9714.

         It currently only works with the atomisp driver.

config VCM_WV511
       tristate "VCM wv511 support"
       depends on I2C && VIDEO_V4L2
       ---help---
         This is a Video4Linux2 sensor-level driver for the wv511.

         It currently only works with the atomisp driver.
	
config VCM_AD5823
       tristate "VCM ad5823 support"
       depends on I2C && VIDEO_V4L2
       ---help---
         This is a Video4Linux2 sensor-level driver for the wv511.

         It currently only works with the atomisp driver.

#
# Kconfig for sensor drivers
#

source "drivers/external_drivers/camera/drivers/media/i2c/ov/Kconfig"
source "drivers/external_drivers/camera/drivers/media/i2c/mt9e013/Kconfig"
source "drivers/external_drivers/camera/drivers/media/i2c/imx/Kconfig"
source "drivers/external_drivers/camera/drivers/media/i2c/imx135VB/Kconfig"
config VIDEO_OV7736
        tristate "OVT ov7736 sensor support"
        depends on I2C && VIDEO_V4L2
        ---help---
          This is a Video4Linux2 sensor-level driver for the OVT
          OV7736 soc camera.

          OVT7736 is a VGA soc sensor.

          It currently only works with the atomisp driver.
	
config VIDEO_OV5670
        tristate "OVT ov5670 sensor support"
        depends on I2C && VIDEO_V4L2
        ---help---
          This is a Video4Linux2 sensor-level driver for the OVT
          OV5670 soc camera.

          OVT5670 is a 5M raw sensor.

          It currently only works with the atomisp driver.
config VIDEO_OV9724
       tristate "OVT ov9724 sensor support"
       depends on I2C && VIDEO_V4L2
       ---help---
         This is a Video4Linux2 sensor-level driver for the OVT
         OV9724 raw camera.

         OV9724 is a 720P raw sensor.

         It currently only works with the atomisp driver.

config VIDEO_OV5693
       tristate "OVT ov5693 sensor support"
       depends on I2C && VIDEO_V4L2
       ---help---
         This is a Video4Linux2 sensor-level driver for the OVT
         OV5693 raw camera.

         OV5693 is a 5M raw sensor.

         It currently only works with the atomisp driver.
config VIDEO_OV2722
       tristate "OVT ov2722 sensor support"
       depends on I2C && VIDEO_V4L2
       ---help---
         This is a Video4Linux2 sensor-level driver for the OVT
         OV2722 raw camera.

         OV2722 is a 2M raw sensor.

         It currently only works with the atomisp driver.


config VIDEO_OV8858
       tristate "OVT ov8858 sensor support"
       depends on I2C && VIDEO_V4L2
       ---help---
         This is a Video4Linux2 sensor-level driver for the OVT
         OV8858 raw camera.

         OV8858 is a 8M raw sensor.

         It currently only works with the atomisp driver.

config VIDEO_OV5648
    tristate "Omnivision ov5648 sensor support"
    depends on I2C && VIDEO_V4L2
    ---help---
      This is a Video4Linux2 sensor-level driver for the Omnivision
      ov5648 5MP RAW sensor.

      It currently only works with the atomisp driver.

config VIDEO_OV2680
       tristate "Omnivision OV2680 sensor support"
       depends on I2C && VIDEO_V4L2
       ---help---
         This is a Video4Linux2 sensor-level driver for the Omnivision
         OV2680 raw camera.

         ov2680 is a 2M raw sensor.

         It currently only works with the atomisp driver.

config VIDEO_BF3A20
   tristate "BYD bf3a20 sensor support"
   depends on I2C && VIDEO_V4L2
   ---help---
     This is a Video4Linux2 sensor-level driver for the BYD
     bf3a20 2M camera.

     It currently only works with the atomisp driver.

config VIDEO_M10MO
	tristate "Fujitsu M10MO driver"
	depends on I2C && VIDEO_V4L2
	---help---
	  This is a Video4Linux2 isp driver for the Fujitsu.

	  It currently depends on internal V4L2 extensions defined in
	  atomisp driver.

config VIDEO_M10MO_FAKE_SFI_TABLE
	bool "Add fake SFI entry for Fujitsu M10MO on VV board + AOB"
	depends on VIDEO_M10MO
	---help---
	  Enable this when working with VV board with Fujitsu AOB.

	  Not needed if device IFWI already has M10MO in the SFI table.

config VIDEO_GC2235
       tristate "Galaxy gc2235 sensor support"
       depends on I2C && VIDEO_V4L2
       ---help---
         This is a Video4Linux2 sensor-level driver for the OVT
         GC2235 raw camera.

         GC2235 is a 2M raw sensor.

         It currently only works with the atomisp driver.


config VIDEO_GC_CLASS
       tristate "Galaxy CLASS driver"
       depends on I2C && VIDEO_V4L2
       ---help---
         This is a Video4Linux2 class driver for GalaxyCore
		 chips.


config VIDEO_GC2155
       tristate "Galaxy gc2155 sensor support"
       depends on I2C && VIDEO_V4L2 && VIDEO_GC_CLASS
       ---help---
         This is a Video4Linux2 sensor-level driver for the OVT
         GC2155 SOC camera.

         GC2155 is a 2M SOC sensor.

         It currently only works with the atomisp driver.

config VIDEO_GC0310SOC
       tristate "Galaxy gc0310 SOC sensor support"
       depends on I2C && VIDEO_V4L2 && VIDEO_GC_CLASS
       ---help---
         This is a Video4Linux2 sensor-level driver for the OVT
         GC0310 SOC camera.

         GC0310 is a 480p SOC sensor.

         It currently only works with the atomisp driver.


config VIDEO_GC5004
    tristate "GC sensor support"
    depends on I2C && VIDEO_V4L2
    ---help---
      This is a Video4Linux2 sensor-level driver for the galaxy
      gc5004 5MP RAW sensor.

      It currently only works with the atomisp driver.

config VIDEO_GC0339
       tristate "GALAXYCORE gc0339 sensor support"
       depends on I2C && VIDEO_V4L2
       ---help---
         This is a Video4Linux2 sensor-level driver for the GALAXYCORE
         GC0339 raw camera.

         gc0339 is a 0.3M raw sensor.

         It currently only works with the atomisp driver.

config VIDEO_GC0310
       tristate "GALAXYCORE gc0310 sensor support"
       depends on I2C && VIDEO_V4L2
       ---help---
         This is a Video4Linux2 sensor-level driver for the GALAXYCORE
         GC0310 raw camera.

         gc0310 is a 0.3M raw sensor.

         It currently only works with the atomisp driver.

config VIDEO_OV8830
       tristate "Omnivision ov8830 sensor support"
       depends on I2C && VIDEO_V4L2 && VIDEO_ATOMISP
       ---help---
         This is a Video4Linux2 sensor-level driver for the Omnivision
         ov8830 8MP RAW sensor.

         It currently only works with the atomisp driver.

config VIDEO_OV8858
       tristate "Omnivision ov8858 sensor support"
       depends on I2C && VIDEO_V4L2 && VIDEO_ATOMISP
       ---help---
         This is a Video4Linux2 sensor-level driver for the Omnivision
         ov8858 8MP RAW sensor.

         It currently only works with the atomisp driver.
	 
config VIDEO_HM2056
  tristate "Himax hm2056 sensor support"
  depends on I2C && VIDEO_V4L2
  ---help---
    This is a Video4Linux2 sensor-level driver for the Himax
    hm2056 2MP RAW sensor.

    It currently only works with the atomisp driver.

config VIDEO_BF3905
         tristate "BYD bf3905 sensor support"
         depends on I2C && VIDEO_V4L2
         ---help---
           This is a Video4Linux2 sensor-level driver for the BYD
           bf3905 0.3M camera.

           It currently only works with the atomisp driver.

config VIDEO_CSI_XACTOR
        tristate "csi xactor"
        depends on I2C && VIDEO_V4L2 && VIDEO_ATOMISP
        ---help---
          Use this if you need to send data through external csi data generator

          To compile this driver as a module, choose M here.

config VIDEO_MSRLIST_HELPER
       tristate "Helper library to load, parse and apply large register lists."
       depends on I2C
       ---help---
         This is a helper library to be used from a sensor driver to load, parse
         and apply large register lists.

         To compile this driver as a module, choose M here: the
         module will be called libmsrlisthelper.

config VIDEO_S5K8AAY
       tristate "Samsung S5K8AAY (EVT1) sensor support"
       depends on I2C && VIDEO_V4L2 && VIDEO_ATOMISP && VIDEO_MSRLIST_HELPER
       ---help---
         This is a Video4Linux2 sensor-level driver for the Samsung
         S5K8AAY (EVT1) 1/8" 1.2MP SoC sensor.

         It currently only works with the atomisp driver.

config VIDEO_S5K6B2YX
       tristate "Samsung S5K6B2YX (VS) sensor support"
       depends on I2C && VIDEO_V4L2 && VIDEO_ATOMISP && VIDEO_MSRLIST_HELPER
       ---help---
         This is a Video4Linux2 sensor-level driver for the Samsung
         S5K6B2YX (VS) 1/6" 2MP RAW sensor.

         It currently only works with the atomisp driver.

config VIDEO_MT9D113
       tristate "Aptina mt9d113 sensor support"
       depends on I2C && VIDEO_V4L2
       ---help---
         This is a Video4Linux2 sensor-level driver for the Micron
         mt9d113 2M camera.

         mt9d113 is video camera sensor.

         It currently only works with the atomisp driver.
config VIDEO_MT9M114
       tristate "Aptina mt9m114 sensor support"
       depends on I2C && VIDEO_V4L2
       ---help---
         This is a Video4Linux2 sensor-level driver for the Micron
         mt9m114 1.3 Mpixel camera.

         mt9m114 is video camrea sensor.
config VIDEO_MT9V113
       tristate "Aptina mt9v113 sensor support"
       depends on I2C && VIDEO_V4L2
       ---help---
         This is a Video4Linux2 sensor-level driver for the Micron
         mt9v113 vga camera.

         mt9v113 is video camerea sensor.

         It currently only works with the atomisp driver.

config VIDEO_OV5640
       tristate "Omnivision ov5640 sensor support"
       depends on I2C && VIDEO_V4L2
       ---help---
         This is a Video4Linux2 sensor-level driver for the Micron
         ov5640 5 Mpixel camera.

         ov5640 is video camrea sensor.

         It currently only works with the atomisp driver.

config VIDEO_AR0543_RAW
        tristate "Aptina ar5693_raw with raw sensor support"
        depends on I2C && VIDEO_V4L2
        ---help---
           This is a Video4Linux2 sensor-level driver for the Aptina
           ar0543 5 Mpixel camera.

           ar0543 is video camrea sensor.

           It currently only works with the atomisp driver.

config VIDEO_HM2056_RAW
        tristate "Himax hm2056_raw with raw sensor support"
        depends on I2C && VIDEO_V4L2
        ---help---
           This is a Video4Linux2 sensor-level driver for the Himax
           hm2056_raw 2 Mpixel camera.

           hm2056_raw is video camrea sensor.

           It currently only works with the atomisp driver.

config VIDEO_AP1302
       tristate "AP1302 external ISP support"
       depends on I2C && VIDEO_V4L2
       ---help---
         This is a Video4Linux2 sensor-level driver for the external
         ISP AP1302.

         AP1302 is an exteral ISP.

         It currently only works with the atomisp driver.

config VIDEO_PIXTER
       tristate "Pixter 2+ MIPI CSI simulator"
       depends on I2C && VIDEO_V4L2
       ---help---
         This is a Video4Linux2 sensor-level driver for Pixter2+.
         Pixter 2+ is a MIPI CSI simulator.

config VIDEO_OV680
       tristate "OV680 external ISP support"
       depends on I2C && VIDEO_V4L2
       ---help---
         This is a Video4Linux2 sensor-level driver for the external
         ISP OV680.

         OV680 is an external ISP.

         It currently only works with the atomisp driver.

config VIDEO_HM5040
       tristate "Himax hm5040 sensor support"
       depends on I2C && VIDEO_V4L2
       ---help---
         This is a Video4Linux2 sensor-level driver for the Himax
         hm5040 5 Mpixel camera.

         hm5040 is video camrea sensor.

         It currently only works with the atomisp driver.

#
# Kconfig for flash drivers
#

config VIDEO_LM3554
       tristate "LM3554 flash light driver"
       depends on VIDEO_V4L2 && I2C
       ---help---
         This is a Video4Linux2 sub-dev driver for the LM3554
         flash light driver.

         To compile this driver as a module, choose M here: the
         module will be called lm3554

config VIDEO_LM3642
       tristate "LM3642 flash light driver"
       depends on VIDEO_V4L2 && I2C
       ---help---
         This is a Video4Linux2 sub-dev driver for the LM3642
         flash light driver.

         To compile this driver as a module, choose M here: the
         module will be called lm3642


config VIDEO_LM3559
       tristate "LM3559 flash light driver"
       depends on VIDEO_V4L2 && I2C
       ---help---
         This is a Video4Linux2 sub-dev driver for the LM3559
         flash light driver.

         To compile this driver as a module, choose M here: the
         module will be called lm3559
```

## linux/modules/camera/drivers/media/i2c/gc/Kconfig
```kconfig
#
# Kconfig for gc2035 sensor driver
#
config VIDEO_GC2155
       tristate "GC 2155 sensor support"
       depends on I2C && VIDEO_V4L2
       ---help---
         This is a Video4Linux2 sensor-level driver for the galaxy
         gc2155 2MP SOC sensor.

         It currently only works with the atomisp driver.
```

## linux/modules/camera/drivers/media/i2c/ov/Kconfig
```kconfig
config VIDEO_OV
       tristate "OV sensor support"
       depends on I2C && VIDEO_V4L2
       ---help---
         This is a Video4Linux2 sensor-level driver for omnivision
         SOC sensor.

         It currently only works with the atomisp driver.

config VIDEO_OV2685
       bool "OV2685 sensor support"
       depends on VIDEO_OV
       ---help---
         This is ov2685 specific data
```

## linux/modules/drivers/gps/intel_mid_gps/Kconfig
```kconfig
#
# Intel MID GPS driver.
#

config INTEL_MID_GPS
	tristate "Intel MID GPS driver"
	default n
	help
	  Select this driver to enable kernel interface for GPS devices
	  used in Intel MID platforms.
	  This driver exports GPIO to user space GPS software
	  that use a standard tty to communicate with the GPS device.

config GPS_CSRGSD5T
	bool  "CSR GPS support instead of platform default"
	depends on INTEL_MID_GPS
	help
	  Select this will enable both RESET and ENALBE pin for csr gps.
```
